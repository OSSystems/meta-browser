## conf/layer.conf
```bitbake
# We have a conf and classes directory, append to BBPATH
BBPATH .= ":${LAYERDIR}"

# We have a recipes directory, add to BBFILES
BBFILES += "${LAYERDIR}/recipes-*/*/*.bb ${LAYERDIR}/recipes-*/*/*.bbappend"

BBFILES_DYNAMIC += " \
	clang-layer:${LAYERDIR}/dynamic-layers/clang-layer/*/*/*.bb \
	clang-layer:${LAYERDIR}/dynamic-layers/clang-layer/*/*/*.bbappend \
	\
	rust-layer:${LAYERDIR}/dynamic-layers/rust-layer/*/*/*.bb \
	rust-layer:${LAYERDIR}/dynamic-layers/rust-layer/*/*/*.bbappend \
"

BBFILE_COLLECTIONS += "browser-layer"
BBFILE_PATTERN_browser-layer := "^${LAYERDIR}/"
BBFILE_PRIORITY_browser-layer = "7"

LAYERVERSION_browser-layer = "1"
LAYERSERIES_COMPAT_browser-layer = "rocko sumo thud warrior"

LAYERDEPENDS_browser-layer = "core openembedded-layer"
```

## meta-chromium-test/conf/layer.conf
```bitbake
BBPATH .= ":${LAYERDIR}"
BBFILES += "${LAYERDIR}/recipes-*/*/*.bb ${LAYERDIR}/recipes-*/*/*.bbappend"

BBFILE_COLLECTIONS += "chromium-test-layer"
BBFILE_PATTERN_chromium-test-layer := "^${LAYERDIR}/"
BBFILE_PRIORITY_chromium-test-layer = "7"

LAYERVERSION_chromium-test-layer = "1"
LAYERSERIES_COMPAT_chromium-test-layer = "kirkstone scarthgap styhead walnascar whinlatter"

LAYERDEPENDS_chromium-test-layer = "chromium-browser-layer"
```

## meta-chromium/conf/layer.conf
```bitbake
# We have a conf and classes directory, append to BBPATH
BBPATH .= ":${LAYERDIR}"

# We have a recipes directory, add to BBFILES
BBFILES += "${LAYERDIR}/recipes-*/*/*.bb ${LAYERDIR}/recipes-*/*/*.bbappend"

BBFILE_COLLECTIONS += "chromium-browser-layer"
BBFILE_PATTERN_chromium-browser-layer := "^${LAYERDIR}/"
BBFILE_PRIORITY_chromium-browser-layer = "7"

LAYERVERSION_chromium-browser-layer = "1"
CHROMIUM_LEGACY_COMPAT = "scarthgap styhead walnascar"
CHROMIUM_COMPAT = "whinlatter"
LAYERSERIES_COMPAT_chromium-browser-layer = "${CHROMIUM_LEGACY_COMPAT} ${CHROMIUM_COMPAT}"
WHINLATTER_OR_NEWER = "${@bb.utils.contains_any('LAYERSERIES_CORENAMES', d.getVar('CHROMIUM_COMPAT'), '1', '0', d)}"
LAYERDEPENDS_chromium-browser-layer = "${@ '' if d.getVar('WHINLATTER_OR_NEWER') == '1' else 'clang-layer'} core openembedded-layer"

# In whinlatter the UNPACKDIR location has changed, and paths created using
# the ${WORKDIR} variable are not valid anymore. However older versions still
# require these.

WHINLATTER_S_PARENT = "${UNPACKDIR}"
NON_WHINLATTER_S_PARENT = "${WORKDIR}"

CORRECT_S_PARENT = "${@d.getVar('WHINLATTER_S_PARENT') if d.getVar('WHINLATTER_OR_NEWER') == '1' else d.getVar('NON_WHINLATTER_S_PARENT')}"
```

## meta-firefox/conf/layer.conf
```bitbake
# We have a conf and classes directory, append to BBPATH
BBPATH .= ":${LAYERDIR}"

# We have a recipes directory, add to BBFILES
BBFILES += "${LAYERDIR}/recipes-*/*/*.bb ${LAYERDIR}/recipes-*/*/*.bbappend"

SIGGEN_EXCLUDERECIPES_ABISAFE += " \
   firefox-l10n-ach \
   firefox-l10n-af \
   firefox-l10n-an \
   firefox-l10n-ar \
   firefox-l10n-ast \
   firefox-l10n-az \
   firefox-l10n-be \
   firefox-l10n-bg \
   firefox-l10n-bn \
   firefox-l10n-br \
   firefox-l10n-bs \
   firefox-l10n-ca \
   firefox-l10n-cak \
   firefox-l10n-ca-valencia \
   firefox-l10n-cs \
   firefox-l10n-cy \
   firefox-l10n-da \
   firefox-l10n-de \
   firefox-l10n-dsb \
   firefox-l10n-el \
   firefox-l10n-en-ca \
   firefox-l10n-en-gb \
   firefox-l10n-en-us \
   firefox-l10n-eo \
   firefox-l10n-es-ar \
   firefox-l10n-es-cl \
   firefox-l10n-es-es \
   firefox-l10n-es-mx \
   firefox-l10n-et \
   firefox-l10n-eu \
   firefox-l10n-fa \
   firefox-l10n-ff \
   firefox-l10n-fi \
   firefox-l10n-fr \
   firefox-l10n-fur \
   firefox-l10n-fy-nl \
   firefox-l10n-ga-ie \
   firefox-l10n-gd \
   firefox-l10n-gl \
   firefox-l10n-gn \
   firefox-l10n-gu-in \
   firefox-l10n-he \
   firefox-l10n-hi-in \
   firefox-l10n-hr \
   firefox-l10n-hsb \
   firefox-l10n-hu \
   firefox-l10n-hy-am \
   firefox-l10n-ia \
   firefox-l10n-id \
   firefox-l10n-is \
   firefox-l10n-it \
   firefox-l10n-ja \
   firefox-l10n-ka \
   firefox-l10n-kab \
   firefox-l10n-kk \
   firefox-l10n-km \
   firefox-l10n-kn \
   firefox-l10n-ko \
   firefox-l10n-lij \
   firefox-l10n-lt \
   firefox-l10n-lv \
   firefox-l10n-mk \
   firefox-l10n-mr \
   firefox-l10n-ms \
   firefox-l10n-my \
   firefox-l10n-nb-no \
   firefox-l10n-ne-np \
   firefox-l10n-nl \
   firefox-l10n-nn-no \
   firefox-l10n-oc \
   firefox-l10n-pa-in \
   firefox-l10n-pl \
   firefox-l10n-pt-br \
   firefox-l10n-pt-pt \
   firefox-l10n-rm \
   firefox-l10n-ro \
   firefox-l10n-ru \
   firefox-l10n-sat \
   firefox-l10n-sc \
   firefox-l10n-sco \
   firefox-l10n-si \
   firefox-l10n-sk \
   firefox-l10n-skr \
   firefox-l10n-sl \
   firefox-l10n-son \
   firefox-l10n-sq \
   firefox-l10n-sr \
   firefox-l10n-sv-se \
   firefox-l10n-szl \
   firefox-l10n-ta \
   firefox-l10n-te \
   firefox-l10n-tg \
   firefox-l10n-th \
   firefox-l10n-tl \
   firefox-l10n-tr \
   firefox-l10n-trs \
   firefox-l10n-uk \
   firefox-l10n-ur \
   firefox-l10n-uz \
   firefox-l10n-vi \
   firefox-l10n-xh \
   firefox-l10n-zh-cn \
   firefox-l10n-zh-tw \
 "

BBFILE_COLLECTIONS += "firefox-browser-layer"
BBFILE_PATTERN_firefox-browser-layer := "^${LAYERDIR}/"
BBFILE_PRIORITY_firefox-browser-layer = "7"

LAYERVERSION_firefox-browser-layer = "2"
LAYERSERIES_COMPAT_firefox-browser-layer = "kirkstone scarthgap walnascar whinlatter"

LAYERDEPENDS_firefox-browser-layer = "core openembedded-layer"
LAYERDEPENDS_firefox-browser-layer:append = '${@"" if "whinlatter" in d.getVar("LAYERSERIES_CORENAMES") else " clang-layer "}'

require conf/post-whinlatter-s-config.inc
```

## meta/conf/layer.conf
```bitbake
# We have a conf and classes directory, append to BBPATH
BBPATH .= ":${LAYERDIR}"

# We have a recipes directory, add to BBFILES
BBFILES += "${LAYERDIR}/recipes-*/*/*.bb ${LAYERDIR}/recipes-*/*/*.bbappend"

BBFILE_COLLECTIONS += "mozilla-layer"
BBFILE_PATTERN_mozilla-layer := "^${LAYERDIR}/"
BBFILE_PRIORITY_mozilla-layer = "7"
```
